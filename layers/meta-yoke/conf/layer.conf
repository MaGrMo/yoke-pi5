## layers/meta-yoke/conf/layer.conf
```bitbake
BBPATH .= ":${LAYERDIR}"
BBFILES += "${LAYERDIR}/recipes-*/*/*.bb ${LAYERDIR}/recipes-*/*/*.bbappend"

BBFILE_COLLECTIONS += "yoke"
BBFILE_PATTERN_yoke = "^${LAYERDIR}/"
BBFILE_PRIORITY_yoke = "20"

LAYERDEPENDS_yoke = "core raspberrypi ros2-layer"
LAYERSERIES_COMPAT_yoke = "scarthgap"
```
